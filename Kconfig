## Kconfig
```kconfig
#
# For a description of the syntax of this configuration file,
# see Documentation/kbuild/kconfig-language.txt.
#
mainmenu "Linux/$ARCH $KERNELVERSION Kernel Configuration"

config T93_PROJ
	bool "T93_PROJ"
	default n

config SRCARCH
	string
	option env="SRCARCH"

# add by hct start
source "Kconfig.hct.common"
source "Kconfig.hct.t25"
source "Kconfig.hct.t925"
source "Kconfig.hct.t93"
source "Kconfig.hct.t985"
source "Kconfig.hct.t89"
source "Kconfig.hct.t99"
# add by hct end

source "arch/$SRCARCH/Kconfig"
```

## Kconfig.hct.common
```kconfig
config HCT_DEVICE_INFO_SUPPORT
	bool "HCT DEVICE INFO SUPPORT"
	default n

config TPD_PROXIMITY
	bool "TPD_PROXIMITY"
	default n

config FINGERPRINT_ET300
	bool "HCT FINGERPRINT_ET300 SUPPORT"
	default n

config HCT_FINGERPRINT_SUPPORT
	bool "HCT HCT_FINGERPRINT_SUPPORT"
	default n

config FINGERPRINT_SILEADE
	bool "HCT FINGERPRINT_SILEADE SUPPORT"
	default n

config FINGERPRINT_NEWSCHIP
	bool "HCT FINGERPRINT_NEWSCHIP SUPPORT"
	default n

config FINGERPRINT_JMT103
	bool "HCT FINGERPRINT_JMT103 SUPPORT"
	default n

config HIGH_BATTERY_VOLTAGE_SUPPORT
	bool "HCT HIGH_BATTERY_VOLTAGE_SUPPORT"
	default n

config CAMERA_SHOT_SUPPORT
	bool "HCT CONFIG_CAMERA_SHOT_SUPPORT"
	default n

config HCT_TP_GESTRUE
	bool "CONFIG_HCT_TP_GESTRUE"
	default n

config HCT_LED_SGM3785
	bool "HCT CONFIG_HCT_LED_SGM3785"
	default n

config HCT_GTP_HALL_CFG
	bool "HCT TP USER DEFERENT CONFIG RELAY ON HALL STATUS"
	default n

config HCT_SDCARD_DEBOUNCE
	bool "HCT SDCARD HAS SW DEBOUNCE"
	default n
	
config MTK_DUMMY_PS
	bool "HCT MTK_DUMMY_PS"
	default n

config HCT_AF_POWER_ON_NOISE
	bool "HCT HCT_AF_POWER_ON_NOISE af dvdd power on in sensor driver to avoid noise"
	default n

config NCP1854_DUAL_SUPPORT
        bool "CONFIG_NCP1854_DUAL_SUPPORT config dual ncp1854 support"
        default n
config HCT_LETTICE_SUPPORT
        bool "CONFIG_HCT_LETTICE_SUPPORT config lettice chip support"
        default n

config LETTICE_VD_SUPPORT
        bool "CONFIG_LETTICE_VD_SUPPORT config lettice voice wakeup feature support"
        default n

config HIGH_4400_BATTERY_VOLTAGE_SUPPORT
	bool "HIGH_4400_BATTERY_VOLTAGE_SUPPORT"
	default n

config NO_RGB_LED_SUPPORT
	bool "CONFIG NO_RGB_LED_SUPPORT"
	default n
config HCT_NCP_HIGHER_CV
	bool "CONFIG_HCT_NCP_HIGHER_CV config ncp1854 higher voltage support"
        default n

config HCT_BATTERY_IMPROVE
        bool "HCT_BATTERY_IMPROVE support"
        default n

config HCT_REMOVE_SIM_HOT_PLUG
        bool "HCT_REMOVE_SIM_HOT_PLUG support"
        default n
config HCT_REMOVE_SD_HOT_PLUG
        bool "HCT_REMOVE_SD_HOT_PLUG support"
        default n
config GSENSOR_ESD_CHECK_NEW_SUPPORT
		bool "GSENSOR_ESD_CHECK_NEW support"
        default n
	
config HCT_SUPPORT_ONEKEY_RST_8SEC
		bool "HCT_SUPPORT_ONEKEY_RST_8SEC support"
	default n
config HCT_BATTERY_IMPROVE
		bool "HCT_BATTERY_IMPROVE support"
        default n
config GSL_TP_HALL_MODE
		bool "GSL_TP_HALL_MODE support"
	default n
```

## Kconfig.hct.t25
```kconfig
config T25_PROJ
	bool "T25_PROJ"
	default n

# t25u-py-p4015-logicom
config T25U_PY_P4015
	bool "T25U_PY_P4015"
	default n

config T25Y_HS_L422_PROJ
	bool "T25Y_HS_L422_PROJ"
	default n
```

## Kconfig.hct.t89
```kconfig
config T89_PROJ
	bool "T89_PROJ"
	default n

config T89P_YX_PROJ
	bool "T89P_YX_PROJ"
	default n

config T89B_OTD_PROJ
	bool "T89B_OTD_PROJ"
	default n

config T89P_HD_PROJ
	bool "T89P_HD_PROJ"
	default n

config T89D_KLT_PROJ
	bool "T89D_KLT_PROJ"
	default n

config T89G_TX_PROJ
	bool "T89G_TX_PROJ"
	default n

config T89J_JK_PROJ
	bool "T89J_JK_PROJ"
	default n

config T89N_TS_PROJ
	bool "T89N_TS_PROJ"
	default n

config T89P_DG_PROJ
	bool "T89P_DG_PROJ"
	default n
```

## Kconfig.hct.t925
```kconfig
config T925_PROJ
	bool "T925_PROJ"
	default n

config T925_TIEPIAN
	bool "T925_TIEPIAN"
	default n

config T925D_NYX_M18
	bool "T925D_NYX_M18"
	default n

config T925M_DH_PROJ
	bool "T925M_DH_PROJ"
	default n

config T925U_YS_T925
	bool "T925U_YS_T925"
	default n
```

## Kconfig.hct.t93
```kconfig
config RGB_LED_SUPPORT
	bool "RGB_LED_SUPPORT"
	default n

config T93E_TS_PROJ
	bool "T93E_TS_PROJ"
	default n

config T93F_ANZHI_PROJ
	bool "T93F_ANZHI_PROJ"
	default n

config T93A_PROJ
	bool "T93A_PROJ"
	default n

config T93Q_LF_PROJ
	bool "T93Q_LF_PROJ"
	default n

config T93H_KLT_PROJ
	bool "T93H_KLT_PROJ"
	default n

config T93M_PROJ
	bool "T93M_PROJ"
	default n
	
config T933_PROJ
	bool "T933_PROJ"
	default n

config T93T_5512_PROJ
	bool "T93t_5512_PROJ"
	default n

config T93E_HAIERT81_TS_PROJ
	bool "T93E_HAIERT81_TS_PROJ"
	default n

config T93P_DK_PROJ
	bool "T93P_DK_PROJ"
	default n
	
config T93D_PROJ
	bool "T93D_PROJ"
	default n

config T93BM_DG_PROJ
	bool "T93BM_DG_PROJ"
	default n

config T93H_KLT_BOM22_PROJ
	bool "T93H_KLT_BOM22_PROJ"
	default n

config T93BQ_PROJ
	bool "T93BQ_PROJ"
	default n

config T93AA_PROJ
	bool "T93AA_PROJ"
	default n

config T93AD_PROJ
	bool "T93AD_PROJ"
	default n

config T93BN_PROJ
	bool "T93BN_PROJ"
	default n
```

## Kconfig.hct.t985
```kconfig
config T985_PROJ
	bool "T985_PROJ"
	default n

config T985B_DWS_PROJ
	bool "T985B_DWS_PROJ"
	default n
```

## Kconfig.hct.t99
```kconfig
config T99_PROJ
	bool "T99_PROJ"
	default n

config T99G_DH_PROJ
	bool "T99G_DH_PROJ"
	default n

config T99L_DWS_PROJ
	bool "T99L_DWS_PROJ"
	default n

config T99F_LF_PROJ
	bool "T99F_LF_PROJ"
	default n

config T991_PROJ
	bool "T991_PROJ"
	default n

config T99C_JQ_PROJ
	bool "T99C_JQ_PROJ"
	default n

config T99M_JXXC_PROJ
	bool "T99C_JXXC_PROJ"
	default n
```
